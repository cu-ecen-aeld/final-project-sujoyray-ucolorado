## aesd_final_project/meta-ti/meta-ti-bsp/conf/machine/include/omapl138_aesd_proj.inc
```bitbake
require conf/machine/include/ti-soc.inc
SOC_FAMILY:append = ":omapl138_aesd_proj"

require conf/machine/include/arm/armv5/tune-arm926ejs.inc

KERNEL_IMAGETYPE = "uImage"

#PREFERRED_PROVIDER_virtual/kernel ?= "linux-ti-staging"
PREFERRED_PROVIDER_virtual/kernel ?= "linux-ti-aesd-proj"
PREFERRED_PROVIDER_virtual/bootloader = "u-boot-ti-staging"
PREFERRED_PROVIDER_u-boot = "u-boot-ti-staging"

EXTRA_IMAGEDEPENDS += "virtual/bootloader"

MACHINE_FEATURES = "kernel26 serial ethernet usbhost usbgadget mmc alsa"
```

## aesd_final_project/meta-ti/meta-ti-bsp/conf/machine/omapl138-aesd_proj.conf
```bitbake
#@TYPE: Machine
#@NAME: OMAP-L138 LCDK
#@DESCRIPTION: Machine configuration for the TI OMAP-L138 LCDK board

require conf/machine/include/omapl138_aesd_proj.inc

#UBOOT_MACHINE = "omapl138_lcdk_config"
UBOOT_MACHINE = "da850evm_nand_config"
UBOOT_SUFFIX = "bin"
SPL_BINARY = "spl/u-boot-spl.ais"

UBOOT_ENTRYPOINT = "0xc0008000"
UBOOT_LOADADDRESS = "0xc0008000"
KERNEL_IMAGE_COMPRESSION = ""
KERNEL_COMPRESSION_LEVEL = "1"
UIMAGE_LOADADDR = "0xc0008000"


#IMAGE_FSTYPES += "tar.xz"
IMAGE_FSTYPES += "ext4"

SERIAL_CONSOLES = "115200;ttyS2"

KERNEL_DEVICETREE = "da850-lcdk_aesd.dtb"
```
